## src/KConfig.projbuild
```kconfig
menu "LOOKin configuration"

    choice FIRMWARE_TARGET_SIZE
        prompt "Target build firmare version"
        default FIRMWARE_TARGET_SIZE_4MB
        help
		  	Please choose SoC size to which firmware need to build

        config FIRMWARE_TARGET_SIZE_4MB
            bool "First gen 4MB devices"

        config FIRMWARE_TARGET_SIZE_16MB
            bool "Second gen 16MB devices"

    endchoice #FIRMWARE_TARGET
endmenu
```
